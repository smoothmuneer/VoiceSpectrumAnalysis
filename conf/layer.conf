## conf/layer.conf
```bitbake
# We have a conf and classes directory, append to BBPATH
BBPATH .= ":${LAYERDIR}"

# We have a recipes directory, add to BBFILES
BBFILES += "${LAYERDIR}/recipes*/*/*.bb ${LAYERDIR}/recipes*/*/*.bbappend"

BBFILE_COLLECTIONS += "jannik"
BBFILE_PATTERN_jannik := "^${LAYERDIR}/"
BBFILE_PRIORITY_jannik = "10"

# Layer dependencies
LAYERDEPENDS_jannik = "phytec openembedded-layer"
LAYERSERIES_COMPAT_jannik = "scarthgap"
```
